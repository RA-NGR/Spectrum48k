#include "Browser.h"

uint8_t fontData[] = { // 8x8 Spectrum font with russian characters, codepage Windows-1251
	0x00, 0x00, 0x00, 0x00, 0x00, 0x00, 0x00, 0x00,
	0x00, 0x10, 0x10, 0x10, 0x10, 0x00, 0x10, 0x00, // !
	0x00, 0x24, 0x24, 0x00, 0x00, 0x00, 0x00, 0x00, // "
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	0x00, 0x00, 0x3C, 0x44, 0x3C, 0x24, 0x44, 0x00  // я
};

void Browser::drawChar(const uint8_t ch, uint8_t posX, uint16_t foreColor, uint16_t backColor)
{
	uint16_t* pBuffer = m_pDisplayInstance->getBuffer();
	if (ch < 32 || posX > 39) return;
	uint16_t glyphPos = (uint16_t)(ch - 32) * 8;
	for (int j = 0; j < 8; j++)
	{
		uint8_t glyphByte = fontData[glyphPos + j];
		for (int i = 0; i < 8; i++)
		{
			if (glyphByte & 0x80)
				pBuffer[j * 320 + i + posX * 8] = foreColor;
			else
				pBuffer[j * 320 + i + posX * 8] = backColor;
			glyphByte <<= 1;
		}
	}
}

void Browser::drawString(const String textStr, uint8_t posX, uint8_t posY, uint16_t foreColor, uint16_t backColor, bool isAnsi)
{
	String decodedStr = "";
	int idx = 0;
	if (!isAnsi)
	{
		int len = textStr.length();
		char ch;
		while (idx < len)
		{
			ch = textStr[idx++];
			//if (ch >= 0xD0)
			//	if (textStr[idx] == 0x81 || textStr[idx] == 0x91)
			//		ch = textStr[idx++] + 0x27;
			//	else
			//		ch = textStr[idx++] + (0x30 + 0x40 * (ch & 0x01));
			//if ((ch & 0x80) != 0x00 && (ch & 0xE0) == 0xC0) ch = ((ch & 0x1F) << 1) | (textStr[idx++] & 0x3F);
			switch (ch)
			{
			case 0xD0:
				ch = textStr[idx++];
				if (ch == 0x81)
					ch = 0xA8;
				else
					if (ch >= 0x90 && ch <= 0xBF) ch += 0x30;
				break;
			case 0xD1:
				ch = textStr[idx++];
				if (ch == 0x91)
					ch = 0xB8;
				else
					if (ch >= 0x80 && ch <= 0x8F) ch += 0x70;
				break;
			default:
				break;
			}
			decodedStr += ch;
		}
	}
	else
		decodedStr = textStr;
	if (posY > 29) return;
	m_pDisplayInstance->setAddrWindow(0, posY * 8, 319, posY * 8 + 7);
	idx = 0;
	while (decodedStr[idx]) drawChar(decodedStr[idx], posX + idx++, foreColor, backColor);
	m_pDisplayInstance->drawBuffer(320 * 8);
}

void Browser::listFiles()
{
	drawString("                                        ", 0, 0, 0xFFFF, 0x1700);
	for (int i = 0; i < 22; i++)
	{
		String outStr = " ";
		outStr += m_browserWindow[i];
		if (outStr.length() > 38)
		{
			String tmp = outStr;
			tmp.toLowerCase();
			int pos = tmp.lastIndexOf(".tap");
			outStr.remove(33, pos - 33);
			outStr.setCharAt(32, '~');
		}
		for (int j = outStr.length(); j < 38; j++) outStr += " ";
		uint16_t backColor = 0x1700, foreColor = 0xF7BD;
		if (m_currDir + m_browserWindow[i] == m_selectedFile) foreColor = 0xE0FF;
		if (outStr[1] == '/') foreColor = 0xFF07;
		if (i + 1 == m_selectionPos)
		{
			backColor = 0xFF07; foreColor = 0x0000;
		}
		drawString(outStr, 1, i + 1, foreColor, backColor, false);
		drawString("                                        ", 0, 23, 0xFFFF, 0x1700);
	}
}

void Browser::chDir()
{
	m_browseFrom = m_selectionPos = 1;
	getFileList();
	dir();
}

void Browser::dir()
{
	int i, posInList = 0;
	for (i = 0; i < 22; i++) m_browserWindow[i] = "";
	for (i = 0; i < m_browseFrom - 1; i++)
	{
		posInList = m_fileList.indexOf("\n", posInList) + 1;
	}
	for (i = 0; i < 22; i++)
	{
		if (m_fileList[posInList] == '\n' || posInList >= m_fileList.length()) break;
		int endOfStr = m_fileList.indexOf("\n", posInList);
		m_browserWindow[i] = m_fileList.substring(posInList, endOfStr);
		posInList = endOfStr + 1;
	}
}

void Browser::getFileList()
{
	m_fileList = "";
	m_filesCount = 0;
	File dirFile = SD.open(m_currDir), entry;
	if (!dirFile) return;
	dirFile.rewindDirectory();
	if (m_currDir != "/" && dirFile.isDirectory())
	{
		m_fileList = "/.."; m_fileList.concat("\n"); m_filesCount++;
	}
	while (entry = dirFile.openNextFile())
	{
		if (entry.isDirectory())m_fileList.concat("/");
		m_fileList.concat(entry.name()); m_filesCount++;
		m_fileList.concat("\n");
		entry.close();
	}
	dirFile.close();
}

void Browser::drawSettingsString()
{
	String volStr[5] = { "ВЫКЛ  ", " 25%  ", " 50%  ", " 75%  ", "100%  " };
	String settingString = "  Громкость: ";
	settingString += volStr[m_settingsData.settings.soundVol];
	settingString += " Режим: Spectrum ";
	settingString += (m_settingsData.settings.machineType == 0 ? "48  " : "128  ");
	drawString(settingString, 0, 25, 0xF7BD, 0x1700, false);
}

void Browser::drawFooter()
{
	drawString("----------------------------------------", 0, 24, 0xF7BD, 0x1700);
//	drawString("                                        ", 0, 24, 0xFFFF, 0x1700);
	drawSettingsString();
	drawString("----------------------------------------", 0, 26, 0xF7BD, 0x1700);
	drawString("                                        ", 0, 27, 0xFFFF, 0x1700);
	drawString("  F1-Спр  F2-Громк  F3-48К/128К  F5-Вых ", 0, 28, 0xE0FF, 0x1700, false);
	drawString("                                        ", 0, 29, 0xFFFF, 0x1700);
}

bool Browser::run()
{
	bool result = false;
	if ((SD.begin(SS, SPI_FULL_SPEED)))
		chDir();
	else
	{
		for (int i = 0; i < 22; i++) m_browserWindow[i] = "";
		m_selectionPos = m_browseFrom = 0;
		m_browserWindow[12] = "            Нет SD-карты";
	}
	listFiles();
	drawFooter();
	while (true)
	{
		if (m_pKeyboardInstance->getData(9) == 0x01)
		{
			LittleFS.begin();
			File helpFile = LittleFS.open("/Help.txt", "r");
			for (int i = 0; i < 26; i++)
			{
				char strData[43];
				helpFile.readBytes(strData, 42);
				strData[40] = 0;
				drawString(strData, 0, i + 2, 0x0000, 0xF7BD);
			}
			helpFile.close();
			LittleFS.end();
			delay(500);
			while (m_pKeyboardInstance->getData(9) != 0x01) yield();
			listFiles();
			drawFooter();
			delay(500);
		}
		if (m_pKeyboardInstance->getData(9) == 0x02)
		{
			m_settingsData.settings.soundVol = (++m_settingsData.settings.soundVol) % 5;
			drawSettingsString();
			delay(500);
		}
		if (m_pKeyboardInstance->getData(9) == 0x04)
		{
			m_settingsData.settings.machineType ^= 1;
			drawSettingsString();
			result = true;
			delay(500);
		}
		if (m_pKeyboardInstance->getData(9) == 0x10) break;
		if (m_pKeyboardInstance->getData(8) == 0x04 && m_selectionPos != 0)
		{
			m_selectionPos++;
			if (m_selectionPos > 22 || m_browserWindow[m_selectionPos - 1] == "")
			{
				m_selectionPos--;
				if (m_browseFrom + 21 < m_filesCount)
				{
					m_browseFrom++; dir(); delay(150);
				}
			}
			else
				delay(150);
			listFiles();
		}
		if (m_pKeyboardInstance->getData(8) == 0x08 && m_selectionPos != 0)
		{
			m_selectionPos--;
			if (m_selectionPos == 0)
			{
				m_selectionPos++;
				if (m_browseFrom > 1)
				{
					m_browseFrom--; dir(); delay(150);
				}
			}
			else
				delay(150);
			listFiles();
		}
		if (m_pKeyboardInstance->getData(8) == 0x10)
		{
			if (m_browserWindow[m_selectionPos - 1][0] == '/')
			{
				if (m_browserWindow[m_selectionPos - 1] == "/..")
				{
					m_currDir.remove(m_currDir.length() - 1);
					m_currDir.remove(m_currDir.lastIndexOf("/") + 1);
				}
				else
				{
					m_currDir.remove(m_currDir.length() - 1);
					m_currDir += m_browserWindow[m_selectionPos - 1];
					m_currDir += "/";
				}
				chDir();
				listFiles();
			}
			else
			{
				m_selectedFile = m_currDir + m_browserWindow[m_selectionPos - 1];
				listFiles();
			}
			delay(500);
		}
		yield();
	}
	saveSettings();
	SD.end();
	return result;
}

void Browser::saveSettings()
{
	LittleFS.begin();
	File settingsFile = LittleFS.open("/settings", "w");
	settingsFile.write(&m_settingsData.raw, 1);
	settingsFile.close();
	LittleFS.end();
}

void Browser::loadSettings()
{
	m_settingsData.raw = 0x04;
	LittleFS.begin();
	File settingsFile = LittleFS.open("/settings", "r");
	if (settingsFile)
	{
		settingsFile.read(&m_settingsData.raw, 1);
		settingsFile.close();
	}
	LittleFS.end();
}